## main/Kconfig.projbuild
```kconfig
menu "P1P2MQTT Configuration"

    choice P1P2_SERIES
        prompt "Daikin series protocol"
        default P1P2_F_SERIES
        help
            Select the Daikin protocol series to support.

        config P1P2_F_SERIES
            bool "F-Series (VRV/Sky Air: FDY, FDYQ, FXMQ)"
        config P1P2_E_SERIES
            bool "E-Series (Altherma)"
    endchoice

    choice P1P2_F_MODEL
        prompt "F-Series model variant"
        default P1P2_F_MODEL_BCL
        depends on P1P2_F_SERIES
        help
            Select the specific F-Series model variant for control packet construction.
            Model A/B/C/L/LA = model 10 (FDY/FBQ type)
            Model P/PA = model 11 (FXMQ type)
            Model M = model 12 (FDYQ type)

        config P1P2_F_MODEL_BCL
            bool "Model A/B/C/L/LA (FDY/FBQ — 0x38 control, 18-byte payload)"
        config P1P2_F_MODEL_P
            bool "Model P/PA (FXMQ — 0x38 control, 20-byte payload)"
        config P1P2_F_MODEL_M
            bool "Model M (FDYQ — 0x3B control, 22-byte payload)"
    endchoice

    config P1P2_F_MODEL_ID
        int
        default 10 if P1P2_F_MODEL_BCL
        default 11 if P1P2_F_MODEL_P
        default 12 if P1P2_F_MODEL_M
        default 10

    menu "GPIO Pin Assignment"
        config P1P2_GPIO_RX
            int "Bus RX pin (MCPWM capture input)"
            default 2
            help
                GPIO connected to XL1192/MM1192 RXD output (bus read).

        config P1P2_GPIO_TX
            int "Bus TX pin (MCPWM generator output)"
            default 3
            help
                GPIO connected to XL1192/MM1192 TXD input (bus write).

        config P1P2_GPIO_ADC0
            int "ADC channel 0 pin (bus voltage P1)"
            default 0
            help
                ADC pin for bus voltage monitoring channel 0.

        config P1P2_GPIO_ADC1
            int "ADC channel 1 pin (bus voltage P2)"
            default 1
            help
                ADC pin for bus voltage monitoring channel 1.

        config P1P2_GPIO_LED_POWER
            int "LED Power (white) GPIO"
            default 4

        config P1P2_GPIO_LED_READ
            int "LED Read (green) GPIO"
            default 5

        config P1P2_GPIO_LED_WRITE
            int "LED Write (blue) GPIO"
            default 6

        config P1P2_GPIO_LED_ERROR
            int "LED Error (red) GPIO"
            default 7
    endmenu

    config P1P2_CONTROL_LEVEL
        int "Default control level (0=off, 1=aux controller, 5=monitor only)"
        default 0
        range 0 5
        help
            Control level for F-series auxiliary controller operation.
            0: Control disabled (read-only monitoring)
            1: Auxiliary controller active (responds to 0x38/0x3B)
            5: Monitor only (listens but does not respond)

endmenu
```

## sdkconfig.defaults
```kconfig
# P1P2MQTT ESP32-C6 — sdkconfig defaults
# Target: ESP32-C6 with Thread/Matter, MCPWM bus I/O

# Target chip
CONFIG_IDF_TARGET="esp32c6"

# ---- Thread / IEEE 802.15.4 ----
CONFIG_OPENTHREAD_ENABLED=y
CONFIG_OPENTHREAD_BORDER_ROUTER=n
CONFIG_OPENTHREAD_FTD=y
CONFIG_OPENTHREAD_SRP_CLIENT=y
CONFIG_OPENTHREAD_DNS_CLIENT=y
CONFIG_OPENTHREAD_LOG_LEVEL_DYNAMIC=n
CONFIG_OPENTHREAD_LOG_LEVEL_NOTE=y

# IEEE 802.15.4 radio
CONFIG_IEEE802154_ENABLED=y

# ---- WiFi disabled (Thread-only device) ----
CONFIG_ESP_WIFI_ENABLED=n

# ---- MCPWM (bus I/O) ----
CONFIG_SOC_MCPWM_SUPPORTED=y

# ---- FreeRTOS ----
CONFIG_FREERTOS_HZ=1000
CONFIG_FREERTOS_UNICORE=y
CONFIG_FREERTOS_TIMER_TASK_PRIORITY=1
CONFIG_FREERTOS_TIMER_TASK_STACK_DEPTH=2048

# ---- Flash / Partitions ----
CONFIG_ESPTOOLPY_FLASHSIZE_4MB=y
CONFIG_PARTITION_TABLE_CUSTOM=y
CONFIG_PARTITION_TABLE_CUSTOM_FILENAME="partitions.csv"

# ---- NVS ----
CONFIG_NVS_ENCRYPTION=n

# ---- Performance / size ----
CONFIG_COMPILER_OPTIMIZATION_SIZE=y

# ---- Console / USB Serial ----
CONFIG_ESP_CONSOLE_USB_SERIAL_JTAG=y
CONFIG_ESP_CONSOLE_SECONDARY_NONE=y

# ---- Log level ----
CONFIG_LOG_DEFAULT_LEVEL_INFO=y
CONFIG_LOG_MAXIMUM_LEVEL_DEBUG=y

# ---- Watchdog ----
CONFIG_ESP_TASK_WDT_TIMEOUT_S=10
CONFIG_ESP_TASK_WDT_EN=y

# ---- Matter (if esp-matter SDK available) ----
CONFIG_ENABLE_CHIP_SHELL=n
CONFIG_BUILD_CHIP_TESTS=n

# Enable HKDF in mbedtls (required by CHIP crypto)
CONFIG_MBEDTLS_HKDF_C=y

# LwIP settings for Thread/Matter
CONFIG_LWIP_IPV6_AUTOCONFIG=y
CONFIG_LWIP_HOOK_IP6_ROUTE_DEFAULT=y
CONFIG_LWIP_HOOK_ND6_GET_GW_DEFAULT=y
CONFIG_LWIP_IPV6_NUM_ADDRESSES=6

# BLE for Matter commissioning
CONFIG_BT_ENABLED=y
CONFIG_BT_NIMBLE_ENABLED=y
CONFIG_BT_NIMBLE_ENABLE_CONN_REATTEMPT=n

# Matter endpoints (we use 8 + root)
CONFIG_ESP_MATTER_MAX_DYNAMIC_ENDPOINT_COUNT=16

# Enable OTA Requestor
CONFIG_ENABLE_OTA_REQUESTOR=y

# Partition table offset (match esp-matter examples)
CONFIG_PARTITION_TABLE_OFFSET=0xC000

# disable softap
CONFIG_ESP_WIFI_SOFTAP_SUPPORT=n

# ---- Exclude unused Matter clusters (optimize flash) ----
# We only need: Thermostat, FanControl, TemperatureMeasurement, OnOff, custom
CONFIG_SUPPORT_ACCOUNT_LOGIN_CLUSTER=n
CONFIG_SUPPORT_ACTIVATED_CARBON_FILTER_MONITORING_CLUSTER=n
CONFIG_SUPPORT_AIR_QUALITY_CLUSTER=n
CONFIG_SUPPORT_APPLICATION_BASIC_CLUSTER=n
CONFIG_SUPPORT_APPLICATION_LAUNCHER_CLUSTER=n
CONFIG_SUPPORT_AUDIO_OUTPUT_CLUSTER=n
CONFIG_SUPPORT_BOOLEAN_STATE_CONFIGURATION_CLUSTER=n
CONFIG_SUPPORT_BRIDGED_DEVICE_BASIC_INFORMATION_CLUSTER=n
CONFIG_SUPPORT_CAMERA_AV_SETTINGS_USER_LEVEL_MANAGEMENT_CLUSTER=n
CONFIG_SUPPORT_CARBON_DIOXIDE_CONCENTRATION_MEASUREMENT_CLUSTER=n
CONFIG_SUPPORT_CARBON_MONOXIDE_CONCENTRATION_MEASUREMENT_CLUSTER=n
CONFIG_SUPPORT_CHANNEL_CLUSTER=n
CONFIG_SUPPORT_CHIME_CLUSTER=n
CONFIG_SUPPORT_CLOSURE_CONTROL_CLUSTER=n
CONFIG_SUPPORT_CLOSURE_DIMENSION_CLUSTER=n
CONFIG_SUPPORT_COMMISSIONER_CONTROL_CLUSTER=n
CONFIG_SUPPORT_CONTENT_LAUNCHER_CLUSTER=n
CONFIG_SUPPORT_CONTENT_CONTROL_CLUSTER=n
CONFIG_SUPPORT_CONTENT_APP_OBSERVER_CLUSTER=n
CONFIG_SUPPORT_DEVICE_ENERGY_MANAGEMENT_CLUSTER=n
CONFIG_SUPPORT_DEVICE_ENERGY_MANAGEMENT_MODE_CLUSTER=n
CONFIG_SUPPORT_DIAGNOSTIC_LOGS_CLUSTER=n
CONFIG_SUPPORT_DISHWASHER_ALARM_CLUSTER=n
CONFIG_SUPPORT_DISHWASHER_MODE_CLUSTER=n
CONFIG_SUPPORT_MICROWAVE_OVEN_MODE_CLUSTER=n
CONFIG_SUPPORT_DOOR_LOCK_CLUSTER=n
CONFIG_SUPPORT_ECOSYSTEM_INFORMATION_CLUSTER=n
CONFIG_SUPPORT_ELECTRICAL_ENERGY_MEASUREMENT_CLUSTER=n
CONFIG_SUPPORT_ELECTRICAL_POWER_MEASUREMENT_CLUSTER=n
CONFIG_SUPPORT_ENERGY_EVSE_CLUSTER=n
CONFIG_SUPPORT_ENERGY_EVSE_MODE_CLUSTER=n
CONFIG_SUPPORT_ENERGY_PREFERENCE_CLUSTER=n
CONFIG_SUPPORT_FAULT_INJECTION_CLUSTER=n
CONFIG_SUPPORT_FIXED_LABEL_CLUSTER=n
CONFIG_SUPPORT_FORMALDEHYDE_CONCENTRATION_MEASUREMENT_CLUSTER=n
CONFIG_SUPPORT_HEPA_FILTER_MONITORING_CLUSTER=n
CONFIG_SUPPORT_ICD_MANAGEMENT_CLUSTER=n
CONFIG_SUPPORT_KEYPAD_INPUT_CLUSTER=n
CONFIG_SUPPORT_LAUNDRY_WASHER_MODE_CLUSTER=n
CONFIG_SUPPORT_LOCALIZATION_CONFIGURATION_CLUSTER=n
CONFIG_SUPPORT_LOW_POWER_CLUSTER=n
CONFIG_SUPPORT_MEDIA_INPUT_CLUSTER=n
CONFIG_SUPPORT_MEDIA_PLAYBACK_CLUSTER=n
CONFIG_SUPPORT_MICROWAVE_OVEN_CONTROL_CLUSTER=n
CONFIG_SUPPORT_MESSAGES_CLUSTER=n
CONFIG_SUPPORT_MODE_SELECT_CLUSTER=n
CONFIG_SUPPORT_NITROGEN_DIOXIDE_CONCENTRATION_MEASUREMENT_CLUSTER=n
CONFIG_SUPPORT_SAMPLE_MEI_CLUSTER=n
CONFIG_SUPPORT_OCCUPANCY_SENSING_CLUSTER=n
CONFIG_SUPPORT_POWER_TOPOLOGY_CLUSTER=n
CONFIG_SUPPORT_OPERATIONAL_STATE_CLUSTER=n
CONFIG_SUPPORT_OPERATIONAL_STATE_OVEN_CLUSTER=n
CONFIG_SUPPORT_OPERATIONAL_STATE_RVC_CLUSTER=n
CONFIG_SUPPORT_OVEN_MODE_CLUSTER=n
CONFIG_SUPPORT_OZONE_CONCENTRATION_MEASUREMENT_CLUSTER=n
CONFIG_SUPPORT_PM10_CONCENTRATION_MEASUREMENT_CLUSTER=n
CONFIG_SUPPORT_PM1_CONCENTRATION_MEASUREMENT_CLUSTER=n
CONFIG_SUPPORT_PM2_5_CONCENTRATION_MEASUREMENT_CLUSTER=n
CONFIG_SUPPORT_POWER_SOURCE_CLUSTER=n
CONFIG_SUPPORT_POWER_SOURCE_CONFIGURATION_CLUSTER=n
CONFIG_SUPPORT_PUMP_CONFIGURATION_AND_CONTROL_CLUSTER=n
CONFIG_SUPPORT_RADON_CONCENTRATION_MEASUREMENT_CLUSTER=n
CONFIG_SUPPORT_REFRIGERATOR_ALARM_CLUSTER=n
CONFIG_SUPPORT_REFRIGERATOR_AND_TEMPERATURE_CONTROLLED_CABINET_MODE_CLUSTER=n
CONFIG_SUPPORT_RVC_CLEAN_MODE_CLUSTER=n
CONFIG_SUPPORT_RVC_RUN_MODE_CLUSTER=n
CONFIG_SUPPORT_SERVICE_AREA_CLUSTER=n
CONFIG_SUPPORT_SMOKE_CO_ALARM_CLUSTER=n
CONFIG_SUPPORT_SOFTWARE_DIAGNOSTICS_CLUSTER=n
CONFIG_SUPPORT_SWITCH_CLUSTER=n
CONFIG_SUPPORT_TARGET_NAVIGATOR_CLUSTER=n
CONFIG_SUPPORT_TEMPERATURE_CONTROL_CLUSTER=n
CONFIG_SUPPORT_THREAD_BORDER_ROUTER_MANAGEMENT_CLUSTER=n
CONFIG_SUPPORT_THREAD_NETWORK_DIRECTORY_CLUSTER=n
CONFIG_SUPPORT_TIME_FORMAT_LOCALIZATION_CLUSTER=n
CONFIG_SUPPORT_TIME_SYNCHRONIZATION_CLUSTER=n
CONFIG_SUPPORT_TIMER_CLUSTER=n
CONFIG_SUPPORT_TVOC_CONCENTRATION_MEASUREMENT_CLUSTER=n
CONFIG_SUPPORT_UNIT_TESTING_CLUSTER=n
CONFIG_SUPPORT_USER_LABEL_CLUSTER=n
CONFIG_SUPPORT_VALVE_CONFIGURATION_AND_CONTROL_CLUSTER=n
CONFIG_SUPPORT_WAKE_ON_LAN_CLUSTER=n
CONFIG_SUPPORT_LAUNDRY_WASHER_CONTROLS_CLUSTER=n
CONFIG_SUPPORT_LAUNDRY_DRYER_CONTROLS_CLUSTER=n
CONFIG_SUPPORT_WIFI_NETWORK_MANAGEMENT_CLUSTER=n
CONFIG_SUPPORT_WINDOW_COVERING_CLUSTER=n
CONFIG_SUPPORT_WATER_HEATER_MANAGEMENT_CLUSTER=n
CONFIG_SUPPORT_WATER_HEATER_MODE_CLUSTER=n
CONFIG_SUPPORT_ELECTRICAL_GRID_CONDITIONS_CLUSTER=n
CONFIG_SUPPORT_COMMODITY_PRICE_CLUSTER=n
CONFIG_SUPPORT_METER_IDENTIFICATION_CLUSTER=n
CONFIG_SUPPORT_UNIT_LOCALIZATION_CLUSTER=n
CONFIG_SUPPORT_COMMODITY_METERING_CLUSTER=n
CONFIG_SUPPORT_COMMODITY_TARIFF_CLUSTER=n
CONFIG_SUPPORT_PUSH_AV_STREAM_TRANSPORT_CLUSTER=n
```
